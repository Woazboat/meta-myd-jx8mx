## conf/layer.conf
```bitbake
# We have a conf and classes directory, add to BBPATH
BBPATH .= ":${LAYERDIR}"

# We have recipes-* directories, add to BBFILES
BBFILES += "${LAYERDIR}/recipes-*/*/*.bb \
            ${LAYERDIR}/recipes-*/*/*.bbappend"

BBFILE_COLLECTIONS += "meta-myd-jx8mx"
BBFILE_PATTERN_meta-myd-jx8mx = "^${LAYERDIR}/"
BBFILE_PRIORITY_meta-myd-jx8mx = "9"

LAYERDEPENDS_meta-myd-jx8mx = "core fsl-bsp-release"

# The optee-os-imx_git recipe causes a parsing error for unknown machines, so we already need to override it in the parsing step
BBMASK_append_myd-jx8mx = " meta-fsl-bsp-release/imx/meta-bsp/recipes-security/optee-imx/optee-os-imx_git.bb "
```

## conf/machine/myd-jx8mx.conf
```bitbake
#@TYPE: Machine
#@NAME: MYIR MYD-JX8MX
#@SOC: i.MX8MQ
#@DESCRIPTION: Machine configuration for MYIR MYD-JX8MX

require ../../../meta-fsl-bsp-release/imx/meta-bsp/conf/machine/imx8mqevk.conf



MACHINE_EXTRA_RRECOMMENDS += " kernel-module-rtl8822b "
MACHINE_EXTRA_RRECOMMENDS_remove = "kernel-module-qcacld-lea"

UBOOT_DTB_NAME = "fsl-imx8mq-evk.dtb"

KERNEL_DEVICETREE = "freescale/myb-fsl-imx8mq-evk.dtb"
```
